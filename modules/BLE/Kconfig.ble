## modules/BLE/Kconfig.ble
```kconfig
# Copyright (c) 2025 Nordic Semiconductor ASA
# SPDX-License-Identifier: LicenseRef-Nordic-5-Clause

rsource "Kconfig.multidomain_channels"

if MDM_BLE

# menuconfig BLE_MODULE
# 	bool "Enable BLE Module"
# 	depends on BT
# 	depends on BT_NUS
# 	default y
# 	help
# 	  Enable the BLE module with Nordic UART Service support.

# if BLE_MODULE

config BLE_MODULE_DK_SUPPORT
	bool "Enable DK LED support"
	depends on DK_LIBRARY
	default y if DK_LIBRARY
	help
	  Enable LED status indication for connection state.

menuconfig MDM_BLE_ZBUS_LOGGING
	bool "Enable ZBUS logging"
	default n
	help
	  Enable local logging of ZBUS messages being sent and received by this module.

if MDM_BLE_ZBUS_LOGGING

config MDM_BLE_ZBUS_LOGGING_STACK_SIZE
	int "ZBUS logging stack size"
	default 1024
	help
	  Stack size used by the ZBUS logging thread.

config MDM_BLE_ZBUS_LOGGING_PRIORITY
	int "ZBUS logging thread priority"
	default 7
	help
	  Thread priority used by the ZBUS logging thread.

endif # MDM_BLE_ZBUS_LOGGING

module = BLE_MODULE
module-str = ble_module
source "subsys/logging/Kconfig.template.log_config"

endif # BLE_MODULE
```

## modules/BLE/Kconfig.multidomain_channels
```kconfig
#
# Copyright (c) 2025 Nordic Semiconductor
#
# SPDX-License-Identifier: LicenseRef-Nordic-5-Clause
#

menuconfig MDM_BLE
	bool "BLE module"
	help
	  Enable BLE module

if MDM_BLE

config MDM_BLE_RUNNER
	bool "Module is running on this image"
	default n
	depends on BT
	depends on BT_NUS
	help
	  Select if this module is running on this image.

endif # MDM_BLE
```

## modules/Kconfig.module_channels
```kconfig
menu "multi-domain-modules"

menuconfig MDM_CHANNELS
	bool "Enable multi-domain modules"
	help
	  Enable multi-domain modules support

if MDM_CHANNELS

rsource "led/Kconfig.multidomain_channels"
rsource "ble_nus/Kconfig.multidomain_channels"

endif # MDM_CHANNELS

endmenu
```

## modules/Kconfig.modules
```kconfig
# Copyright (c) 2025 Nordic Semiconductor ASA
# SPDX-License-Identifier: LicenseRef-Nordic-5-Clause

menu "multi-domain-modules"

menuconfig MDM
	bool "Enable multi-domain modules"
	help
	  Enable multi-domain modules support

if MDM

rsource "led/Kconfig.multidomain"
rsource "ble_nus/Kconfig.multidomain"
rsource "channel_sounding/Kconfig.multidomain"

endif # MDM

endmenu
```

## modules/ble_nus/Kconfig.ble_nus
```kconfig
# Copyright (c) 2025 Nordic Semiconductor ASA
# SPDX-License-Identifier: LicenseRef-Nordic-5-Clause

rsource "Kconfig.multidomain"

if MDM_BLE_NUS

config MDM_BLE_NUS_RUNNER
	bool "Module is running on this image"
	select BT
	select BT_PERIPHERAL
	select BT_NUS
	select BT_SETTINGS
	select SETTINGS
	select FLASH
	select FLASH_PAGE_LAYOUT
	select FLASH_MAP
	select NVS
	select MPU_ALLOW_FLASH_WRITE
	select DK_LIBRARY
	default n
	help
	  Select if this module is running on this image.

if MDM_BLE_NUS_RUNNER

config BT_DEVICE_NAME
	default "MDM_UART_Service"

config BT_MAX_PAIRED
	default 1

config BLE_NUS_CONN_TIMEOUT
	int "BLE connection supervision timeout (units of 10ms)"
	default 100
	range 10 3200
	help
	  Connection supervision timeout for NUS connections.
	  Value is in units of 10ms. Range: 100ms (10) to 32s (3200).
	  Default 100 = 1000ms.

config HEAP_MEM_POOL_SIZE
	default 2048

config BLE_NUS_MODULE_DK_SUPPORT
	bool "Enable DK LED support"
	depends on DK_LIBRARY
	default y if DK_LIBRARY
	help
	  Enable LED status indication for connection state.

module = MDM_BLE_NUS
module-str = mdm_ble_nus
source "subsys/logging/Kconfig.template.log_config"

endif # MDM_BLE_NUS_RUNNER

endif # MDM_BLE_NUS
```

## modules/ble_nus/Kconfig.multidomain
```kconfig
# Copyright (c) 2025 Nordic Semiconductor ASA
# SPDX-License-Identifier: LicenseRef-Nordic-5-Clause

menuconfig MDM_BLE_NUS
	bool "BLE NUS module"
	help
	  Enable BLE NUS module.
	  Note: Cannot be used simultaneously with Channel Sounding module due to
	  BLE role conflicts (BLE NUS requires peripheral, Channel Sounding requires
	  central-only mode).

if MDM_BLE_NUS

menuconfig MDM_BLE_NUS_ZBUS_LOGGING
	bool "Enable ZBUS logging"
	default n
	help
	  Enable local logging of ZBUS messages being sent and received by this module.

if MDM_BLE_NUS_ZBUS_LOGGING

config MDM_BLE_NUS_ZBUS_LOGGING_STACK_SIZE
	int "ZBUS logging stack size"
	default 1024
	help
	  Stack size used by the ZBUS logging thread.

config MDM_BLE_NUS_ZBUS_LOGGING_PRIORITY
	int "ZBUS logging thread priority"
	default 7
	help
	  Thread priority used by the ZBUS logging thread.

endif # MDM_BLE_NUS_ZBUS_LOGGING

endif # MDM_BLE_NUS
```

## modules/ble_nus/Kconfig.multidomain_channels
```kconfig
#
# Copyright (c) 2025 Nordic Semiconductor
#
# SPDX-License-Identifier: LicenseRef-Nordic-5-Clause
#

menuconfig MDM_BLE_NUS
	bool "BLE NUS module"
	help
	  Enable BLE NUS module.
	  Note: Cannot be used simultaneously with Channel Sounding module due to
	  BLE role conflicts (BLE NUS requires peripheral, Channel Sounding requires
	  central-only mode).

if MDM_BLE_NUS

config MDM_BLE_NUS_RUNNER
	bool "Module is running on this image"
	default n
	depends on BT
	depends on BT_NUS
	help
	  Select if this module is running on this image.

endif # MDM_BLE_NUS
```

## modules/ble_nus/Kconfig.sysbuild
```kconfig
# Copyright (c) 2025 Nordic Semiconductor
# SPDX-License-Identifier: LicenseRef-Nordic-5-Clause

if MDM_BLE_NUS

config NRF_DEFAULT_BLUETOOTH
	default y

config NETCORE_IPC_RADIO_BT_HCI_IPC
	default y

rsource "sysbuild/ipc_radio/Kconfig.ipc_radio"

endif # MDM_BLE_NUS
```

## modules/ble_nus/sysbuild/ipc_radio/Kconfig.ipc_radio
```kconfig
# Copyright (c) 2025 Nordic Semiconductor
# SPDX-License-Identifier: LicenseRef-Nordic-5-Clause

config ipc_radio_CONFIG_SERIAL
	bool
	default n

config ipc_radio_CONFIG_UART_CONSOLE
	bool
	default n

config ipc_radio_CONFIG_LOG
	bool
	default n

config ipc_radio_CONFIG_BT_PERIPHERAL
	bool
	default y

config ipc_radio_CONFIG_BT_MAX_CONN
	int
	default 1

config ipc_radio_CONFIG_BT_MAX_PAIRED
	int
	default 1

config ipc_radio_CONFIG_BT_DEVICE_NAME
	string
	default "Nordic_UART_Service"
```

## modules/channel_sounding/Kconfig.channel_sounding
```kconfig
# Copyright (c) 2025 Nordic Semiconductor ASA
# SPDX-License-Identifier: LicenseRef-Nordic-5-Clause

rsource "Kconfig.multidomain"

if MDM_CHANNEL_SOUNDING

config MDM_CHANNEL_SOUNDING_RUNNER
	bool "This image runs the multi-domain Channel Sounding module"
	default n
	select NCS_SAMPLES_DEFAULTS
	select DK_LIBRARY
	select BT
	select BT_SMP
	select BT_CENTRAL
	select BT_GATT_CLIENT
	select BT_GATT_DYNAMIC_DB
	select BT_CHANNEL_SOUNDING
	select BT_RAS
	select BT_RAS_RREQ
	select BT_SCAN
	select BT_SCAN_FILTER_ENABLE
	select BT_CS_DE
	select BT_CS_DE_512_NFFT
	select BT_TRANSMIT_POWER_CONTROL
	select FPU
	select FPU_SHARING
	select CBPRINTF_FP_SUPPORT


if MDM_CHANNEL_SOUNDING_RUNNER

config BT_BONDABLE
	default n

config BT_RAS_MODE_3_SUPPORTED
	default n

config BT_RAS_MAX_ANTENNA_PATHS
	default 1

config BT_CTLR_SDC_CS_MAX_ANTENNA_PATHS
	default 1

config BT_CTLR_SDC_CS_NUM_ANTENNAS
	default 1

config BT_CTLR_SDC_CS_STEP_MODE3
	default n

choice BT_CTLR_SDC_CS_ROLE
	default BT_CTLR_SDC_CS_ROLE_INITIATOR_ONLY
endchoice

config BT_CTLR_CHANNEL_SOUNDING_TEST
	default n

config BT_SCAN_UUID_CNT
	default 1

config BT_L2CAP_TX_MTU
	default 498

config BT_BUF_ACL_TX_SIZE
	default 502

config BT_BUF_ACL_RX_SIZE
	default 502

config BT_ATT_PREPARE_COUNT
	default 3

config BT_CTLR_DATA_LENGTH_MAX
	default 251

config CHANNEL_SOUNDING_THREAD_STACK_SIZE
	int "Channel Sounding thread stack size"
	default 4096
	help
	  Stack size for the channel sounding thread.

config CHANNEL_SOUNDING_THREAD_PRIORITY
	int "Channel Sounding thread priority"
	default 7
	help
	  Priority for the channel sounding thread.

module = MDM_CHANNEL_SOUNDING
module-str = mdm_channel_sounding
source "subsys/logging/Kconfig.template.log_config"

endif # MDM_CHANNEL_SOUNDING_RUNNER

endif # MDM_CHANNEL_SOUNDING
```

## modules/channel_sounding/Kconfig.multidomain
```kconfig
# Copyright (c) 2025 Nordic Semiconductor
# SPDX-License-Identifier: LicenseRef-Nordic-5-Clause

menuconfig MDM_CHANNEL_SOUNDING
	bool "Channel Sounding module"
	help
	  Enable Channel Sounding module.
	  Note: Cannot be used simultaneously with BLE NUS module due to
	  BLE role conflicts.

if MDM_CHANNEL_SOUNDING

config MDM_CHANNEL_SOUNDING_ZBUS_LOGGING
	bool "Enable ZBUS logging"
	default n
	help
	  Enable local logging of ZBUS messages being sent and received by this module.

endif # MDM_CHANNEL_SOUNDING
```

## modules/channel_sounding/Kconfig.sysbuild
```kconfig
#
# Copyright (c) 2025 Nordic Semiconductor
#
# SPDX-License-Identifier: LicenseRef-Nordic-5-Clause
#

if MDM_CHANNEL_SOUNDING

config NRF_DEFAULT_BLUETOOTH
	default y

config NETCORE_IPC_RADIO_BT_HCI_IPC
	default y

endif # MDM_CHANNEL_SOUNDING
```

## modules/channel_sounding/sysbuild/hci_ipc/Kconfig.hci_ipc
```kconfig
# Copyright (c) 2025 Nordic Semiconductor ASA
# SPDX-License-Identifier: LicenseRef-Nordic-5-Clause

config ipc_radio_CONFIG_IPC_SERVICE
	bool
	default y

config ipc_radio_CONFIG_MBOX
	bool
	default y

config ipc_radio_CONFIG_HEAP_MEM_POOL_SIZE
	int
	default 4096

config ipc_radio_CONFIG_BT
	bool
	default y

config ipc_radio_CONFIG_BT_HCI_RAW
	bool
	default y

config ipc_radio_CONFIG_BT_CENTRAL
	bool
	default y

config ipc_radio_CONFIG_BT_CTLR_CHANNEL_SOUNDING
	bool
	default y

config ipc_radio_CONFIG_BT_CTLR_CHANNEL_SOUNDING_TEST
	bool
	default n

config ipc_radio_CONFIG_BT_CTLR_DATA_LENGTH_MAX
	int
	default 251

config ipc_radio_CONFIG_BT_CTLR_PHY_2M
	bool
	default y

config ipc_radio_CONFIG_BT_BUF_EVT_RX_SIZE
	int
	default 255

config ipc_radio_CONFIG_BT_CTLR_SDC_CS_MAX_ANTENNA_PATHS
	int
	default 1

config ipc_radio_CONFIG_BT_CTLR_SDC_CS_NUM_ANTENNAS
	int
	default 1

config ipc_radio_CONFIG_BT_CTLR_SDC_CS_STEP_MODE3
	bool
	default n
```

## modules/led/Kconfig.led
```kconfig
# Copyright (c) 2025 Nordic Semiconductor ASA
# SPDX-License-Identifier: LicenseRef-Nordic-5-Clause

rsource "Kconfig.multidomain"

if MDM_LED

config MDM_LED_RUNNER
	bool "This image runs the multi-domain LED module"
	default n
	select GPIO
	select DK_LIBRARY
	select LED
	help
	  Select if this module is running on this image.

if MDM_LED_RUNNER

module = MDM_LED
module-str = mdm_led
source "subsys/logging/Kconfig.template.log_config"

endif # MDM_LED_RUNNER

endif # MDM_LED
```

## modules/led/Kconfig.multidomain
```kconfig
# Copyright (c) 2025 Nordic Semiconductor ASA
# SPDX-License-Identifier: LicenseRef-Nordic-5-Clause

menuconfig MDM_LED
	bool "LED module"
	help
	  Enable multi-domain LED module.

if MDM_LED

config MDM_LED_ZBUS_LOGGING
	bool "Enable ZBUS logging"
	default n
	help
	  Enable local logging of ZBUS messages being sent and received by this module.

endif # MDM_LED
```

## modules/led/Kconfig.multidomain_channels
```kconfig
#
# Copyright (c) 2025 Nordic Semiconductor
#
# SPDX-License-Identifier: LicenseRef-Nordic-5-Clause
#

menuconfig MDM_LED
	bool "LED"
	select LED
	help
	  Enable LED

if MDM_LED

config MDM_LED_RUNNER
	bool "Module is running on this image"
	default n
	help
	  Select if this module is running on this image.

endif # APP_LED
```
