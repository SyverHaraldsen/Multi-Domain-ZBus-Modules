## CMakeLists.txt
```
#
# Copyright (c) 2025 Nordic Semiconductor ASA
#
# SPDX-License-Identifier: LicenseRef-Nordic-5-Clause
#

cmake_minimum_required(VERSION 3.20.0)

find_package(Zephyr REQUIRED HINTS $ENV{ZEPHYR_BASE})
project("Multi-Domain-Modules")

target_sources(app PRIVATE src/main.c)

target_compile_definitions(app PRIVATE "MDM_LED_PROXY_NODE=DT_NODELABEL(uart_proxy_agent)")
target_compile_definitions(app PRIVATE "MDM_BLE_NUS_PROXY_NODE=DT_NODELABEL(uart_proxy_agent)")
target_compile_definitions(app PRIVATE "MDM_CHANNEL_SOUNDING_PROXY_NODE=DT_NODELABEL(uart_proxy_agent)")

add_subdirectory_ifdef(CONFIG_MDM_BLE_NUS_RUNNER ../modules/ble_nus ${CMAKE_BINARY_DIR}/modules/ble_nus)
add_subdirectory_ifdef(CONFIG_MDM_LED_RUNNER ../modules/led ${CMAKE_BINARY_DIR}/modules/led)
add_subdirectory_ifdef(CONFIG_MDM_CHANNEL_SOUNDING_RUNNER ../modules/channel_sounding ${CMAKE_BINARY_DIR}/modules/channel_sounding)
```

## Kconfig
```
# Copyright (c) 2025 Nordic Semiconductor ASA
# SPDX-License-Identifier: LicenseRef-Nordic-5-Clause

rsource "../modules/ble_nus/Kconfig.ble_nus"
rsource "../modules/led/Kconfig.led"
rsource "../modules/channel_sounding/Kconfig.channel_sounding"

# BLE connection management
config BT_MAX_CONN
	default 2 if (MDM_BLE_NUS_RUNNER && MDM_CHANNEL_SOUNDING_RUNNER)
	default 1

# Dual-role BLE support when both modules are enabled
if MDM_BLE_NUS_RUNNER && MDM_CHANNEL_SOUNDING_RUNNER

config BT_PERIPHERAL
	default y

config BT_CENTRAL
	default y

endif

source "Kconfig.zephyr"
```

## Kconfig.sysbuild
```
# Copyright (c) 2025 Nordic Semiconductor ASA
# SPDX-License-Identifier: LicenseRef-Nordic-5-Clause

source "share/sysbuild/Kconfig"

rsource "../modules/ble_nus/Kconfig.sysbuild"
rsource "../modules/channel_sounding/Kconfig.sysbuild"
```

## prj.conf
```kconfig
# Copyright (c) 2025 Nordic Semiconductor ASA
# SPDX-License-Identifier: LicenseRef-Nordic-5-Clause

######################
## Modules
######################

# Enable BLE NUS Module
CONFIG_MDM_BLE_NUS=y
CONFIG_MDM_BLE_NUS_RUNNER=y
CONFIG_MDM_BLE_NUS_ZBUS_LOGGING=y

# Enable LED Module
CONFIG_MDM_LED=y
CONFIG_MDM_LED_RUNNER=y
CONFIG_MDM_LED_ZBUS_LOGGING=y

# Enable Channel Sounding Module
CONFIG_MDM_CHANNEL_SOUNDING=y
CONFIG_MDM_CHANNEL_SOUNDING_RUNNER=y
CONFIG_MDM_CHANNEL_SOUNDING_ZBUS_LOGGING=y

######################
## Application
######################

# Zbus multi-domain support
CONFIG_ZBUS=y
CONFIG_ZBUS_CHANNEL_NAME=y
CONFIG_ZBUS_MSG_SUBSCRIBER=y
CONFIG_POLL=y
CONFIG_ZBUS_PROXY_AGENT=y

# Zbus UART backend
CONFIG_CRC=y
CONFIG_SERIAL=y
CONFIG_UART_ASYNC_API=y
CONFIG_ZBUS_PROXY_AGENT_UART=y

# Config logger
CONFIG_LOG=y
CONFIG_LOG_BACKEND_UART=y
CONFIG_LOG_BUFFER_SIZE=4096
CONFIG_LOG_PROCESS_THREAD_STACK_SIZE=2048
CONFIG_LOG_MODE_DEFERRED=y
CONFIG_LOG_DBG_COLOR_BLUE=y
```

## boards/nrf54l15dk_nrf54l15_cpuapp.conf
```kconfig
#
# Copyright (c) 2025 Nordic Semiconductor
#
# SPDX-License-Identifier: LicenseRef-Nordic-5-Clause
#

# Disable the unsupported UART0 driver
CONFIG_NRFX_UARTE0=n
```

## boards/nrf54l15dk_nrf54l15_cpuapp.overlay
```dts
/*
 * Copyright (c) 2025 Nordic Semiconductor ASA
 *
 * SPDX-License-Identifier: LicenseRef-Nordic-5-Clause
 */

/ {
	chosen {
		nordic,nus-uart = &uart20;
	};

	uart_proxy_agent: uart-proxy {
		compatible = "zephyr,zbus-proxy-agent-uart";
		status = "okay";
		uart-device = <&uart30>;
	};
};

&uart30 {
	status = "okay";
	current-speed = <1000000>;
	/delete-property/ hw-flow-control;
};
```

## boards/nrf54lm20dk_nrf54lm20a_cpuapp.overlay
```dts
/*
 * Copyright (c) 2025 Nordic Semiconductor ASA
 * SPDX-License-Identifier: LicenseRef-Nordic-5-Clause
 */

/ {
	chosen {
		nordic,nus-uart = &uart20;
	};

	uart_proxy_agent: uart-proxy {
		compatible = "zephyr,zbus-proxy-agent-uart";
		status = "okay";
		uart-device = <&uart30>;
	};
};

&uart30 {
	status = "okay";
	current-speed = <1000000>;
	/delete-property/ hw-flow-control;
};
```

## src/main.c
```c
/*
 * Copyright (c) 2025 Nordic Semiconductor ASA
 *
 * SPDX-License-Identifier: LicenseRef-Nordic-5-Clause
 */

#include <zephyr/kernel.h>
#include <zephyr/zbus/zbus.h>

#include <zephyr/logging/log.h>
LOG_MODULE_REGISTER(main, LOG_LEVEL_DBG);


int main(void)
{
	LOG_INF("Module runner started");
	while (1) {
		k_sleep(K_SECONDS(10));
		LOG_INF("Module runner alive");
	}
	return 0;
}
```
